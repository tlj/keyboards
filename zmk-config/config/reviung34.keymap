#include <behaviors.dtsi>
#include <dt-bindings/zmk/bt.h>
#include <dt-bindings/zmk/keys.h>
#include <dt-bindings/zmk/rgb.h>

#define HOST_OS 2
#include "../zmk-nodefree-config/helper.h"
#include "../zmk-nodefree-config/keypos_def/keypos_34keys.h"
#include "../zmk-nodefree-config/international_chars/danish.dtsi"
#include "includes/custom_keycodes.dtsi"

#define L_DEF 0
#define L_SYM 1
#define L_NUM 2
#define L_NAV 3
#define L_MED 4
#define L_NOR 5

#define AS(keycode) &as LS(keycode) keycode 

/ {
    chosen {
        // 34 keys.
        zmk,matrix_transform = &dual_1u_transform;
    };
};

ZMK_COMBO(esc, &kp ESC, RM1 RM2, L_DEF, 40)
ZMK_COMBO(enter, &kp ENTER, LM1 LM2, L_DEF, 40)
ZMK_COMBO(caps, &caps_word, LB1 LB2, L_DEF, 40)

ZMK_BEHAVIOR(hrm, hold_tap,
  flavor = "tap-preferred";
  tapping-term-ms = <150>;
  quick-tap-ms = <100>;
  bindings = <&kp>, <&kp>;
)

&caps_word {
  /delete-property/ ignore-modifiers;
};

/ {
  behaviors {
    as: auto_shift {
      compatible = "zmk,behavior-hold-tap";
      #binding-cells = <2>;
      tapping-term-ms = <150>;
      quick-tap-ms = <0>;
      flavor = "tap-preferred";
      bindings = <&kp>, <&kp>;
    };
  };

  keymap {
    compatible = "zmk,keymap";

    base {
      display-name = "Base";
      bindings = <
    //╭─────────────┬─────────────┬─────────────────┬─────────────────┬─────────────────╮ ╭─────────────────┬───────────────┬──────────────┬───────────────┬────────────────╮
        &kp Q         &kp W         &kp E             &kp R             &kp T               &kp Y             &kp U           &kp I           &kp O          &kp P
    //├─────────────┼─────────────┼─────────────────┼─────────────────┼─────────────────┤ ├─────────────────┼───────────────┼──────────────┼───────────────┼────────────────┤
        &hrm LALT A   &hrm LCTRL S  &hrm LCMD D       &hrm LSHIFT F     &lt L_NAV G         &lt L_NUM H       &hrm LSHIFT J   &hrm LCMD K     &hrm LCTRL L   &hrm LALT SEMI
    //├─────────────┼─────────────┼─────────────────┼─────────────────┼─────────────────┤ ├─────────────────┼───────────────┼──────────────┼───────────────┼────────────────┤
        &kp Z         &kp X         &lt L_NOR C       &kp V             &kp B               &kp N             &kp M           &kp COMMA       &kp DOT        &kp ENTER
    //╰─────────────┼─────────────┼─────────────────┼─────────────────┼─────────────────┤ ├─────────────────┼───────────────┼──────────────┼───────────────┼────────────────╯
                                    &lt L_MED BSPC    &lt L_SYM SPACE   &hrm MY_MEH TAB     &lt L_SYM SPACE
    //                            ╰─────────────────┴─────────────────┴─────────────────╯ ╰─────────────────╯
        >;
    };

    symbol {
      display-name = "Symbol";
      bindings = <
    //╭─────────────┬─────────────┬─────────────────┬─────────────────┬─────────────────╮ ╭─────────────────┬───────────────┬──────────────┬───────────────┬────────────────╮
        &none         &kp PRCNT     &kp LBRC          &kp RBRC          &kp CARET           &kp AMPS          &kp GRAVE       &kp APOS       &none           &none
    //├─────────────┼─────────────┼─────────────────┼─────────────────┼─────────────────┤ ├─────────────────┼───────────────┼──────────────┼───────────────┼────────────────┤
        &kp LSHIFT    &kp AT        &kp LPAR          &kp RPAR          &kp DOLLAR          &kp SLASH         &kp COLON       AS(EQUAL)      &kp DQT         &kp RSHIFT
    //├─────────────┼─────────────┼─────────────────┼─────────────────┼─────────────────┤ ├─────────────────┼───────────────┼──────────────┼───────────────┼────────────────┤
        &none         &kp EXCL      &kp LBKT          &kp RBKT          &kp STAR            &kp PIPE          &kp BSLH        AS(MINUS)      &kp UNDER       &none
    //╰─────────────┼─────────────┼─────────────────┼─────────────────┼─────────────────┤ ├─────────────────┼───────────────┼──────────────┼───────────────┼────────────────╯
                                    &none             &none             &none               &none
    //                            ╰─────────────────┴─────────────────┴─────────────────╯ ╰─────────────────╯
        >;
    };

    number {
      display-name = "Number";
      bindings = <
    //╭─────────────┬─────────────┬─────────────────┬─────────────────┬─────────────────╮ ╭─────────────────┬───────────────┬──────────────┬───────────────┬────────────────╮
        &none         &none         AS(N7)            AS(N8)            AS(N9)              &none             &none           &none           &none          &none
    //├─────────────┼─────────────┼─────────────────┼─────────────────┼─────────────────┤ ├─────────────────┼───────────────┼──────────────┼───────────────┼────────────────┤
        &kp LSHIFT    &none         AS(N4)            AS(N5)            AS(N6)              &none             &kp LSHIFT      &none           &none          &kp LSHIFT
    //├─────────────┼─────────────┼─────────────────┼─────────────────┼─────────────────┤ ├─────────────────┼───────────────┼──────────────┼───────────────┼────────────────┤
        &none         &none         AS(N1)            AS(N2)            AS(N3)              &none             &none           &none           &none          &none
    //╰─────────────┼─────────────┼─────────────────┼─────────────────┼─────────────────┤ ├─────────────────┼───────────────┼──────────────┼───────────────┼────────────────╯
                                    &none             AS(N0)            &kp ENTER           &none
    //                            ╰─────────────────┴─────────────────┴─────────────────╯ ╰─────────────────╯
        >;
    };

    navig {
      display-name = "Navigation";
      bindings = <
    //╭─────────────┬─────────────┬─────────────────┬─────────────────┬─────────────────╮ ╭─────────────────┬───────────────┬──────────────┬───────────────┬────────────────╮
        &kp F1        &kp F2        &kp F3            &kp F4            &kp F5              &kp F6            &kp F7          &kp F8         &kp F9          &kp F10
    //├─────────────┼─────────────┼─────────────────┼─────────────────┼─────────────────┤ ├─────────────────┼───────────────┼──────────────┼───────────────┼────────────────┤
        &kp LALT      &kp LCTRL     &kp LCMD          &kp LSHIFT        &none               &kp LEFT          &kp DOWN        &kp UP         &kp RIGHT       &none
    //├─────────────┼─────────────┼─────────────────┼─────────────────┼─────────────────┤ ├─────────────────┼───────────────┼──────────────┼───────────────┼────────────────┤
        &kp F11       &kp F12       &none             &none             &none               &kp HOME          &kp PG_DN       &kp PG_UP      &kp END         &none
    //╰─────────────┼─────────────┼─────────────────┼─────────────────┼─────────────────┤ ├─────────────────┼───────────────┼──────────────┼───────────────┼────────────────╯
                                    &none             &none             &none               &none
    //                            ╰─────────────────┴─────────────────┴─────────────────╯ ╰─────────────────╯
        >;
    };

    media {
      display-name = "Media";
      bindings = <
    //╭─────────────┬─────────────┬─────────────────┬─────────────────┬─────────────────╮ ╭─────────────────┬───────────────┬──────────────┬───────────────┬────────────────╮
        &none         &none         &none             &none             &none               &none             &none           &none          &none           &none
    //├─────────────┼─────────────┼─────────────────┼─────────────────┼─────────────────┤ ├─────────────────┼───────────────┼──────────────┼───────────────┼────────────────┤
        &none         &none         &none             &none             &none               &kp K_MUTE        &kp C_VOL_DN    &kp C_VOL_UP   &none           &none
    //├─────────────┼─────────────┼─────────────────┼─────────────────┼─────────────────┤ ├─────────────────┼───────────────┼──────────────┼───────────────┼────────────────┤
        &none         &none         &none             &none             &none               &kp C_PP          &kp C_PREV      &kp C_NEXT     &none           &none
    //╰─────────────┼─────────────┼─────────────────┼─────────────────┼─────────────────┤ ├─────────────────┼───────────────┼──────────────┼───────────────┼────────────────╯
                                    &none             &bootloader       &none               &none
    //                            ╰─────────────────┴─────────────────┴─────────────────╯ ╰─────────────────╯
        >;
    };

    norwegian {
      display-name = "norwegian";
      bindings = <
    //╭─────────────┬─────────────┬─────────────────┬─────────────────┬─────────────────╮ ╭─────────────────┬───────────────┬──────────────┬───────────────┬────────────────╮
        &none         &none         &none             &none             &none               &none             &none           &none          &none           &none
    //├─────────────┼─────────────┼─────────────────┼─────────────────┼─────────────────┤ ├─────────────────┼───────────────┼──────────────┼───────────────┼────────────────┤
        &none         &none         &none             &none             &none               &none             &dk_ae          &dk_oe         &dk_aa          &none
    //├─────────────┼─────────────┼─────────────────┼─────────────────┼─────────────────┤ ├─────────────────┼───────────────┼──────────────┼───────────────┼────────────────┤
        &none         &none         &none             &none             &none               &none             &none           &none          &none           &none
    //╰─────────────┼─────────────┼─────────────────┼─────────────────┼─────────────────┤ ├─────────────────┼───────────────┼──────────────┼───────────────┼────────────────╯
                                    &none             &none             &none               &none
    //                            ╰─────────────────┴─────────────────┴─────────────────╯ ╰─────────────────╯
        >;
    };
  };
};

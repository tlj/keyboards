## zmk-config/boards/shields/bluetyl/Kconfig.defconfig
```kconfig
if SHIELD_BLUETYL_LEFT

config ZMK_KEYBOARD_NAME
  default "Bluetyl"

config ZMK_SPLIT_ROLE_CENTRAL
  default y

endif

if SHIELD_BLUETYL_LEFT || SHIELD_BLUETYL_RIGHT

config ZMK_SPLIT
  default y

endif
```

## zmk-config/boards/shields/bluetyl/Kconfig.shield
```kconfig
config SHIELD_BLUETYL_LEFT
  def_bool $(shields_list_contains, bluetyl_left)

config SHIELD_BLUETYL_RIGHT
  def_bool $(shields_list_contains, bluetyl_right)
```
